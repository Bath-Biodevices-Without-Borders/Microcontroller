#undef pinMode
#include <MCP23017.h>
#include <Wire.h>
#include <SPI.h>
#include <Adafruit_GFX.h>
#include <Adafruit_SSD1306.h>
#include <stdint.h>
#include <ArduinoBLE.h>

#include "odk_gps.h"
#include "odk_ble.h"

extern TinyGPSPlus gps;
extern BLECharacteristic anlgCh0Chstic;
extern BLECharacteristic anlgCh1Chstic;

#define SCREEN_WIDTH 128 // OLED display width, in pixels
#define SCREEN_HEIGHT 64 // OLED display height, in pixels

#define OLED_MOSI  38
#define OLED_CLK   48
#define OLED_DC    18
#define OLED_CS    21
#define OLED_RESET 17

#define GPS_RX D1
#define GPS_TX D0

#define SR_DATA  7
#define SR_LATCH 9
#define SR_CLOCK 8

Adafruit_SSD1306 display(SCREEN_WIDTH, SCREEN_HEIGHT,
  OLED_MOSI, OLED_CLK, OLED_DC, OLED_RESET, OLED_CS);

uint16_t analogue_0 = 0;  // variable to store the value coming from the sensor
uint16_t analogue_1 = 0;

#define ODK_SPLASH_HEIGHT 64
#define ODK_SPLASH_WIDTH 128

// array size is 1024
static const uint8_t PROGMEM ODK_splash[] = {
    0b00000000, 0b00000000, 0b00000000, 0b00000000, 0b00000000, 0b00000000, 0b00000000, 0b00000000, 0b00000000, 0b00000000, 0b00000000, 0b00000000, 0b00000000, 0b00000000, 0b00000000, 0b00000000, 
    0b00000000, 0b00000000, 0b00000000, 0b00000000, 0b00000000, 0b00000000, 0b00000000, 0b00000000, 0b00000000, 0b00000000, 0b00000000, 0b00000000, 0b00000000, 0b00000000, 0b00000000, 0b00000000, 
    0b00000000, 0b00000000, 0b00000000, 0b00000000, 0b01110000, 0b00000000, 0b00000000, 0b00000000, 0b00000000, 0b00000000, 0b00000000, 0b00000000, 0b00000000, 0b00000000, 0b00000000, 0b00000000, 
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    0b00000000, 0b00000000, 0b00000000, 0b00000000, 0b00000000, 0b00000000, 0b00000000, 0b00000000, 0b00000000, 0b00000000, 0b00000000, 0b00000000, 0b00000000, 0b00000000, 0b00000000, 0b00000000
};

#define MCP23017_ADDR 0x20
MCP23017 mcp = MCP23017(MCP23017_ADDR);

void setup() {

    // SSD1306_SWITCHCAPVCC = generate display voltage from 3.3V internally
    if(!display.begin(SSD1306_SWITCHCAPVCC)) {
        Serial.println(F("SSD1306 allocation failed"));
        for(;;); // Don't proceed, loop forever
    }
    display.clearDisplay();
    display.drawBitmap(0,0,ODK_splash, ODK_SPLASH_WIDTH, ODK_SPLASH_HEIGHT,1);
    display.display();
	for (int i = 0; i < 10; i ++)
	{
		delay(100);
		display.invertDisplay(1);
		delay(100);
		display.invertDisplay(0);
	}

    Wire.begin();
    Serial.begin(115200);
    
    mcp.init();
    mcp.portMode(MCP23017Port::A, 0);          //Port A as output
    mcp.portMode(MCP23017Port::B, 0b11111111); //Port B as input

    mcp.writeRegister(MCP23017Register::GPIO_A, 0x00);    //Reset port A 
    mcp.writeRegister(MCP23017Register::GPIO_B, 0x00);    //Reset port B

    // GPIO_B reflects the same logic as the input pins state
    mcp.writeRegister(MCP23017Register::IPOL_B, 0x00);
    // Uncomment this line to invert inputs (press a button to lit a led)
    //mcp.writeRegister(MCP23017Register::IPOL_B, 0xFF);

    display.setTextSize(1);      // Normal 1:1 pixel scale
    display.setTextColor(SSD1306_WHITE); // Draw white text

    srInit();

    ble_init();
	gps_init();
	gps_poll(true);
}

uint8_t mux_sel= 0;
uint8_t mux_sel_r = 0;
uint8_t mux_sel_out = 0;
void loop() {
    uint8_t currentB;
    currentB = mcp.readPort(MCP23017Port::B);
    //Serial.println(currentB,BIN);

	gps_poll();
	ble_poll();

    srDriveAllBits(~currentB);
    if (mux_sel < 8) {
        if (0x01 & ~currentB) {
            mux_sel += 1;
            delay(250);
        }
    } else {
        mux_sel = 0;
    }

    mux_sel_r = reverseBits(mux_sel,3);
    mcp.writeRegister(MCP23017Register::GPIO_A, mux_sel_r);  //Reset port A 


	char anlg0string[5] = "9999";
	char anlg1string[5] = "9999";
    analogue_0 = analogRead(1);
    analogue_1 = analogRead(2);
	sprintf(anlg0string, "%4d",analogue_0);
	sprintf(anlg1string, "%4d",analogue_1);
	anlgCh0Chstic.writeValue((byte*)anlg0string, 4);
	anlgCh1Chstic.writeValue((byte*)anlg1string, 4);

    display.clearDisplay();
    display.setCursor(0, 0);     // Start at top-left corner
	display.print(gps.date.year());display.print(F("/"));display.print(gps.date.month());display.print(F("/"));display.print(gps.date.day());display.print(F("  "));display.print(gps.time.hour());display.print(F(":"));display.print(gps.time.minute());display.print(F(":"));display.println(gps.time.second());
	display.print(F("Latitude: ")); display.println(gps.location.lat());
	display.print(F("Longitude: ")); display.println(gps.location.lng());
	display.println();
    display.print(F("Analogue Port: ")); display.println(mux_sel);
    display.print(F("Analogue 0: ")); display.println(analogue_0);
    display.print(F("Analogue 1: ")); display.println(analogue_1);
    display.display();
    // uint8_t bits = 0x01;
    // for (int i=0; i<8; i++) {
    //     bang_those_bits(bits);
    //     bits = bits << 1;
    //     delay(1000);
    // }    
}

void srInit() {
    // set pins to output
    pinMode(SR_DATA, OUTPUT);
    pinMode(SR_LATCH, OUTPUT);
    pinMode(SR_CLOCK, OUTPUT);
    
    // drive all pins low
    digitalWrite(SR_DATA, LOW);
    digitalWrite(SR_LATCH, LOW);
    digitalWrite(SR_CLOCK, LOW);

    // clear the register 
    for (int i=0; i<8; i++) {
        digitalWrite(SR_CLOCK, HIGH);
        digitalWrite(SR_CLOCK, LOW);
    }

    // latch cleared register
    digitalWrite(SR_LATCH, HIGH);
    digitalWrite(SR_LATCH, LOW);
}


uint8_t reverseBits(uint8_t num, uint8_t bitSize) {
    uint8_t reversed = 0;

    // Loop through each bit in the number
    for (uint8_t i = 0; i < bitSize; i++) {
        // Extract the least significant bit of `num` and shift it to its reversed position
        if (num & (1 << i)) {
            reversed |= (1 << (bitSize - 1 - i));
        }
    }
    
    return reversed;
}

void srDriveAllBits (uint8_t bits) {
    // drive the entire bitstring in 'bits' to the shift register

    uint8_t top_bit;
    for (int i=0; i<8; i++) {
        // get the top bit
        top_bit = bits & 0x80;
        // shift the sequence left
        bits = bits << 1;
        // set the data either high or low based on the top bit
        if (top_bit) {
            digitalWrite(SR_DATA, HIGH);
        } else {
            digitalWrite(SR_DATA, LOW);
        }
        // clock bit into register
        digitalWrite(SR_CLOCK, HIGH);
        digitalWrite(SR_CLOCK, LOW);
    }
    // latch the final sequence
    digitalWrite(SR_LATCH, HIGH);
    digitalWrite(SR_LATCH, LOW);
}
